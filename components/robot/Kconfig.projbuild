## components/robot/Kconfig.projbuild
```kconfig
menu "Robot Hardware"

config ESP32_DEV_BOARD_VERSION
    string "Development Board Model"
    default "esp32_adafruit.h"
    help
        The hardware works across different versions of the ESP32 development board. Depending on the dev board the pins are different.
        Choose from either esp32_adafruit.h or esp32_doit_am.h

endmenu
```

## components/wifi/Kconfig.projbuild
```kconfig
menu "WIFI Configuration"

config WIFI_AP_SSID
    string "ssid"
    default "Pako Bots"
    help
        SSID (network name) AP network name shown in the broadcast.

config WIFI_AP_PASSWORD
    string "password"
    default ""
    help
        WiFi password required for a client to connect. Leave this blank for no password.

endmenu
```
